#pragma once

#include <math.h>
#include <string.h>
#include "config.h"

// ─── Native C/C++ Replacements for Arduino.h ─────────────────────────────────
#ifndef max
#define max(a,b) ((a)>(b)?(a):(b))
#endif

#ifndef min
#define min(a,b) ((a)<(b)?(a):(b))
#endif
// ─────────────────────────────────────────────────────────────────────────────


// ─────────────────────────────────────────────────────────────────────────────
//  preprocessing.h  –  PPG signal processing pipeline
//
//  Pipeline (mirrors the Python notebook):
//   1. Invert
//   2. Resample  (→ 100 Hz, linear interpolation)
//   3. Bandpass  (3rd-order Butterworth 0.5–6 Hz via cascaded SOS)
//   4. Peak + Valley detection
//   5. Cubic spline baseline removal → segments[]
//   6. Take last 15 segments
//   7. MinMax normalise (global, across all 15 segments concatenated)
//   8. Zero-pad each segment to SEG_LEN=100 & concatenate → signal_1500
//   9. Build mask_1500  (1=real, 0=pad)
// ─────────────────────────────────────────────────────────────────────────────

// ─── Helpers ─────────────────────────────────────────────────────────────────
static inline float clampf(float v, float lo, float hi) {
    return v < lo ? lo : (v > hi ? hi : v);
}
static inline float medianf(float* a, int n) {
    // Simple insertion sort then pick middle
    float tmp[n];
    memcpy(tmp, a, n * sizeof(float));
    for (int i = 1; i < n; i++) {
        float key = tmp[i]; int j = i - 1;
        while (j >= 0 && tmp[j] > key) { tmp[j+1] = tmp[j]; j--; }
        tmp[j+1] = key;
    }
    return tmp[n/2];
}

// ─── 1. Invert ────────────────────────────────────────────────────────────────
inline void invert_signal(float* sig, int n) {
    for (int i = 0; i < n; i++) sig[i] = -sig[i];
}

// ─── 2. Linear resample ───────────────────────────────────────────────────────
// Returns new length.
inline int resample_linear(const float* in, int n_in,
                    float* out, int max_out,
                    float fs_in, float fs_out) {
    int n_out = (int)((float)n_in * fs_out / fs_in);
    if (n_out > max_out) n_out = max_out;
    float ratio = fs_in / fs_out;
    for (int i = 0; i < n_out; i++) {
        float t   = i * ratio;
        int   idx = (int)t;
        float frc = t - idx;
        if (idx + 1 < n_in)
            out[i] = in[idx] * (1.0f - frc) + in[idx+1] * frc;
        else
            out[i] = in[idx < n_in ? idx : n_in-1];
    }
    return n_out;
}

// ─── 3. Butterworth Bandpass (SOS) ───────────────────────────────────────────
//
// Coefficients generated by:
//   from scipy.signal import butter
//   sos = butter(3, [0.5/50, 6.0/50], btype='band', output='sos')
//   print(repr(sos))
//
// Replace the values below with the output of that command.
//
// Layout: sos[section][b0,b1,b2,a0,a1,a2]  (a0 is always 1)
//
static const float SOS_COEFF[BP_ORDER][6] = {
    // ← PASTE scipy output here ─────────────────────────────────────────────
    { 0.00241379f,  0.0f,        -0.00241379f,  1.0f, -1.97985042f,  0.98527620f },
    { 1.0f,         2.0f,         1.0f,          1.0f, -1.71197073f,  0.82265193f },
    { 1.0f,        -2.0f,         1.0f,          1.0f, -1.94789044f,  0.95551714f },
    // ────────────────────────────────────────────────────────────────────────
};

// Direct Form II Transposed biquad filter (single section, in-place)
static inline void biquad_dfII(float* x, int n,
                         float b0, float b1, float b2,
                         float a1, float a2) {
    float w1 = 0.0f, w2 = 0.0f;
    for (int i = 0; i < n; i++) {
        float w0 = x[i] - a1*w1 - a2*w2;
        x[i]     = b0*w0 + b1*w1 + b2*w2;
        w2 = w1; w1 = w0;
    }
}

// Forward-backward (zero-phase) SOS filter  (mimics scipy filtfilt)
inline void bandpass_ppg(float* sig, int n) {
    // Forward pass
    for (int s = 0; s < BP_ORDER; s++) {
        const float* c = SOS_COEFF[s];
        biquad_dfII(sig, n, c[0], c[1], c[2], c[4], c[5]);
    }
    // Reverse array
    for (int i = 0, j = n-1; i < j; i++, j--) {
        float tmp = sig[i]; sig[i] = sig[j]; sig[j] = tmp;
    }
    // Backward pass
    for (int s = 0; s < BP_ORDER; s++) {
        const float* c = SOS_COEFF[s];
        biquad_dfII(sig, n, c[0], c[1], c[2], c[4], c[5]);
    }
    // Reverse back
    for (int i = 0, j = n-1; i < j; i++, j--) {
        float tmp = sig[i]; sig[i] = sig[j]; sig[j] = tmp;
    }
}

// ─── 4a. Peak detection ───────────────────────────────────────────────────────
// Returns count of peaks written into peaks[].
inline int find_peaks_ppg(const float* sig, int n, float fs,
                   int* peaks, int max_peaks) {
    int    min_dist  = (int)(PEAK_MIN_DIST_S * fs);
    // Auto prominence from MAD
    float  med = 0;
    {
        float tmp[n];
        memcpy(tmp, sig, n * sizeof(float));
        med = medianf(tmp, n);
    }
    float  mad = 0;
    {
        float tmp[n];
        for (int i = 0; i < n; i++) tmp[i] = fabsf(sig[i] - med);
        mad = medianf(tmp, n) + 1e-8f;
    }
    float  min_prom = PEAK_PROM_MAD_MULT * mad;

    int cnt = 0;
    int last_peak = -min_dist - 1;
    for (int i = 1; i < n - 1; i++) {
        if (sig[i] > sig[i-1] && sig[i] > sig[i+1]) {
            if (i - last_peak < min_dist) continue;
            // Prominence: how much above surrounding minima
            float left_min  = sig[i];
            for (int j = max(0, i-20*min_dist); j < i; j++)
                if (sig[j] < left_min) left_min = sig[j];
            float right_min = sig[i];
            for (int j = i+1; j < min(n, i+20*min_dist); j++)
                if (sig[j] < right_min) right_min = sig[j];
            float prom = sig[i] - max(left_min, right_min);
            if (prom < min_prom) continue;
            if (cnt < max_peaks) peaks[cnt++] = i;
            last_peak = i;
        }
    }
    return cnt;
}

// ─── 4b. Valley detection ─────────────────────────────────────────────────────
// For each peak, find minimum in window [peak - vmax_s, peak - vmin_s].
inline int find_valleys_ppg(const float* sig, int n, float fs,
                     const int* peaks, int n_peaks,
                     int* valleys, int max_valleys) {
    int vmin = (int)(VALLEY_SEARCH_MIN_S * fs);
    int vmax = (int)(VALLEY_SEARCH_MAX_S * fs);
    int cnt  = 0;

    for (int pi = 0; pi < n_peaks; pi++) {
        int p     = peaks[pi];
        int left  = max(0, p - vmax);
        int right = max(0, p - vmin);
        if (right <= left) continue;
        int   best_idx = left;
        float best_val = sig[left];
        for (int j = left+1; j < right; j++) {
            if (sig[j] < best_val) { best_val = sig[j]; best_idx = j; }
        }
        valleys[cnt++] = best_idx;
        if (cnt >= max_valleys) break;
    }
    // Deduplicate (simple pass since already ordered)
    int uniq = 0;
    for (int i = 0; i < cnt; i++) {
        if (uniq == 0 || valleys[i] != valleys[uniq-1])
            valleys[uniq++] = valleys[i];
    }
    return uniq;
}

// ─── 5. Natural cubic spline ─────────────────────────────────────────────────
// Solve for spline through (x[0..n-1], y[0..n-1]) and evaluate at all
// integer indices from x[0] to x[n-1], writing to baseline[].
// Uses the Thomas algorithm for the tridiagonal system.
// baseline must be of length at least x[n-1]+1.
inline void cubic_spline_eval(const int* xs, const float* ys, int n,
                       float* baseline, int bl_len) {
    if (n < 2) return;
    int m = n - 1;  // number of intervals

    // h[i] = xs[i+1] - xs[i]
    float h[n];
    for (int i = 0; i < m; i++) h[i] = (float)(xs[i+1] - xs[i]);

    // Build RHS (Thomas algorithm, natural BC: M[0]=M[m]=0)
    float diag[n], sub[n], rhs[n];
    rhs[0] = 0.0f; diag[0] = 1.0f; sub[0] = 0.0f;
    for (int i = 1; i < m; i++) {
        rhs[i]  = 6.0f * ((ys[i+1] - ys[i])/h[i] - (ys[i] - ys[i-1])/h[i-1]);
        diag[i] = 2.0f * (h[i-1] + h[i]);
        sub[i]  = h[i];
    }
    rhs[m] = 0.0f; diag[m] = 1.0f;

    // Forward sweep
    for (int i = 1; i <= m; i++) {
        float w = h[i-1] / diag[i-1];
        diag[i] -= w * sub[i-1];
        rhs[i]  -= w * rhs[i-1];
    }
    // Back substitution (M = second derivatives)
    float M[n];
    M[m] = rhs[m] / diag[m];
    for (int i = m-1; i >= 0; i--)
        M[i] = (rhs[i] - sub[i]*M[i+1]) / diag[i];

    // Evaluate spline at every integer index from xs[0] to xs[m]
    for (int i = 0; i < m; i++) {
        int a = xs[i], b = xs[i+1];
        float hi = h[i];
        for (int t = a; t <= b && t < bl_len; t++) {
            float dt = (float)(t - a);
            float db = (float)(b - t);
            baseline[t] =
                (M[i]/(6.0f*hi))   * db*db*db +
                (M[i+1]/(6.0f*hi)) * dt*dt*dt +
                (ys[i]/hi - M[i]*hi/6.0f)   * db +
                (ys[i+1]/hi - M[i+1]*hi/6.0f) * dt;
        }
    }
}

// ─── Full pipeline ────────────────────────────────────────────────────────────
//
//  Inputs:
//    raw[]          – raw ADC values, length n_raw
//    fs_raw         – actual sample rate of raw signal (Hz)
//    resampled_buf  – scratch buffer, length >= MAX_RESAMP_SAMPLES
//    valleys_out[]  – output valley indices (into filtered signal)
//    peaks_out[]    – output peak indices
//    n_valleys_out  – number of valleys written
//    n_peaks_out    – number of peaks written
//
//  Outputs (pre-allocated by caller):
//    signal_1500[]  – float[1500] normalised, padded signal
//    mask_1500[]    – float[1500] mask (1=real, 0=pad)
//    detrended_out  – pointer to detrended signal start inside resampled_buf
//                     (valid from valley[0] to valley[last]; same lifetime as resampled_buf)
//    n_detrended    – length of detrended region
//    fs_out         – NEW_FREQUENCY
//
//  Returns: true on success, false if not enough segments detected.
// ─────────────────────────────────────────────────────────────────────────────

// Working buffers (static to avoid stack overflow on ESP32)
static float _resampled[MAX_RESAMP_SAMPLES];
static float _baseline[MAX_RESAMP_SAMPLES];
static float _detrended_buf[MAX_RESAMP_SAMPLES];
static int   _peaks[MAX_PEAKS];
static int   _valleys[MAX_VALLEYS];
// Per-segment start/end indices into detrended (relative to valley[0])
static int   _seg_start[MAX_VALLEYS];
static int   _seg_end[MAX_VALLEYS];

inline bool preprocess_pipeline(
    const float* raw, int n_raw, float fs_raw,
    float* signal_1500, float* mask_1500,
    float** detrended_out, int* n_detrended)
{
    // ── Step 1: Invert ───────────────────────────────────────────────────────
    static float _inverted[MAX_RAW_SAMPLES];
    for (int i = 0; i < n_raw; i++) _inverted[i] = -raw[i];

    // ── Step 2: Resample ─────────────────────────────────────────────────────
    int n_res = resample_linear(_inverted, n_raw, _resampled, MAX_RESAMP_SAMPLES,
                                fs_raw, NEW_FREQUENCY);

    // ── Step 3: Bandpass filter ──────────────────────────────────────────────
    // Work on a copy so we preserve _resampled for later
    memcpy(_detrended_buf, _resampled, n_res * sizeof(float));
    bandpass_ppg(_detrended_buf, n_res);   // in-place, zero-phase

    // ── Step 4: Detect peaks → valleys ──────────────────────────────────────
    int n_peaks   = find_peaks_ppg(_detrended_buf, n_res, NEW_FREQUENCY,
                                   _peaks, MAX_PEAKS);
    int n_valleys = find_valleys_ppg(_detrended_buf, n_res, NEW_FREQUENCY,
                                     _peaks, n_peaks, _valleys, MAX_VALLEYS);

    if (n_valleys < 2) return false;

    // ── Step 5: Spline baseline removal ─────────────────────────────────────
    // Build y-array at valley positions
    static float vy[MAX_VALLEYS];
    for (int i = 0; i < n_valleys; i++) vy[i] = _detrended_buf[_valleys[i]];

    memset(_baseline, 0, n_res * sizeof(float));
    cubic_spline_eval(_valleys, vy, n_valleys, _baseline, n_res);

    // Subtract baseline only between first and last valley
    int v0 = _valleys[0], vN = _valleys[n_valleys-1];
    for (int i = v0; i <= vN && i < n_res; i++)
        _detrended_buf[i] -= _baseline[i];

    // Expose detrended region to caller
    *detrended_out = _detrended_buf + v0;
    *n_detrended   = vN - v0 + 1;

    // Adjust valley indices relative to v0
    static int rel_valleys[MAX_VALLEYS];
    for (int i = 0; i < n_valleys; i++) rel_valleys[i] = _valleys[i] - v0;

    // ── Step 6: Build segments relative to v0 ───────────────────────────────
    int n_segs = n_valleys - 1;
    for (int i = 0; i < n_segs; i++) {
        _seg_start[i] = rel_valleys[i];
        _seg_end[i]   = rel_valleys[i+1];  // inclusive
    }

    // ── Step 7: Take last NUM_SEGMENTS ──────────────────────────────────────
    int first_seg = max(0, n_segs - NUM_SEGMENTS);
    int used_segs = n_segs - first_seg;  // ≤ NUM_SEGMENTS
    if (used_segs < 1) return false;

    // Concatenate the selected segments to find global min/max
    int total_len = 0;
    for (int s = first_seg; s < n_segs; s++)
        total_len += (_seg_end[s] - _seg_start[s] + 1);

    float gmin =  1e9f, gmax = -1e9f;
    for (int s = first_seg; s < n_segs; s++) {
        float* seg_ptr = *detrended_out + _seg_start[s];
        int    seg_len = _seg_end[s] - _seg_start[s] + 1;
        for (int j = 0; j < seg_len; j++) {
            if (seg_ptr[j] < gmin) gmin = seg_ptr[j];
            if (seg_ptr[j] > gmax) gmax = seg_ptr[j];
        }
    }
    float rng = gmax - gmin;
    if (rng < 1e-8f) rng = 1e-8f;

    // ── Step 8: Normalise + zero-pad + build output ──────────────────────────
    memset(signal_1500, 0, SIGNAL_LEN * sizeof(float));
    memset(mask_1500,   0, SIGNAL_LEN * sizeof(float));

    // Pad from the front when fewer than NUM_SEGMENTS are available
    int out_offset = (NUM_SEGMENTS - used_segs) * SEG_LEN;

    for (int s = 0; s < used_segs; s++) {
        int si       = first_seg + s;
        float* sp    = *detrended_out + _seg_start[si];
        int    raw_l = _seg_end[si] - _seg_start[si] + 1;
        int    real_l = min(raw_l, SEG_LEN);

        for (int j = 0; j < real_l; j++) {
            float norm_val = (sp[j] - gmin) / rng;
            signal_1500[out_offset + j] = norm_val;
            mask_1500  [out_offset + j] = 1.0f;
        }
        out_offset += SEG_LEN;
    }

    return true;
}

// ─── Heart rate from detrended signal ─────────────────────────────────────────
inline float sample_heart_rate(const float* sig, int n, float fs) {
    int min_dist = (int)(0.4f * fs);  // 150 bpm upper bound
    int peaks[200];
    int cnt = 0;
    for (int i = 1; i < n-1; i++) {
        if (sig[i] > sig[i-1] && sig[i] > sig[i+1]) {
            if (cnt == 0 || (i - peaks[cnt-1]) >= min_dist) {
                if (sig[i] > 0.01f && cnt < 200) peaks[cnt++] = i;
            }
        }
    }
    if (cnt < 2) return NAN;
    float sum_rr = 0;
    for (int i = 1; i < cnt; i++) sum_rr += (float)(peaks[i] - peaks[i-1]);
    float mean_rr = sum_rr / (cnt - 1) / fs;
    return roundf(60.0f / mean_rr * 10.0f) / 10.0f;
}

// ─── StandardScaler transform ────────────────────────────────────────────────
// Scales: age, weight, bmi, height, actual_hr  (order matches SCALER_MEAN/STD)
// Binary features (sex, preop_htn, preop_dm) are passed through unchanged.
inline void scale_demographics(float& age, float& weight, float& bmi,
                         float& height, float& actual_hr) {
    age       = (age       - SCALER_MEAN[0]) / SCALER_STD[0];
    weight    = (weight    - SCALER_MEAN[1]) / SCALER_STD[1];
    bmi       = (bmi       - SCALER_MEAN[2]) / SCALER_STD[2];
    height    = (height    - SCALER_MEAN[3]) / SCALER_STD[3];
    actual_hr = (actual_hr - SCALER_MEAN[4]) / SCALER_STD[4];
}